## config/boards/shields/KobitoKey/Kconfig.defconfig
```kconfig
# 左右共通（ドングル構成ではペリフェラル）
if SHIELD_KOBITOKEY_LEFT || SHIELD_KOBITOKEY_RIGHT
config ZMK_SPLIT
    default y
config ZMK_SPLIT_ROLE_CENTRAL
    default n
config ZMK_POINTING
    default y
config SPI
    default y
endif

# ドングル（セントラル）
if SHIELD_KOBITOKEY_DONGLE
config ZMK_KEYBOARD_NAME
    default "KobitoKey"

config ZMK_SPLIT_ROLE_CENTRAL
    default y

config ZMK_SPLIT
    default y

config ZMK_SPLIT_BLE_CENTRAL_PERIPHERALS
    default 2

config BT_MAX_CONN
    default 7

config BT_MAX_PAIRED
    default 7
endif
```
